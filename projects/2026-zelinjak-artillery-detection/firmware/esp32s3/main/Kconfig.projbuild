## projects/2026-zelinjak-artillery-detection/firmware/esp32s3/main/Kconfig.projbuild
```kconfig
menu "Gunshot classifier data link"

    config APP_DATA_LINK_USB_SERIAL_JTAG
        bool "Use native USB-Serial/JTAG for MFCC data link instead of UART0"
        default n
        help
            This board exposes two USB-C ports: one wired to the native
            USB-Serial/JTAG peripheral (used by esptool for flashing/monitor),
            and one wired to UART0 through a discrete USB-to-UART bridge chip.

            By default (n), the classifier data link (init_uart / the receive
            loop in main.cpp) uses the physical UART0 pins, matching the
            original wiring for a real deployment where a host talks to the
            board over that dedicated UART port.

            Enable this (y) to instead exchange MFCC data over the same native
            USB-Serial/JTAG port already used for flashing - convenient when
            only that port is connected (e.g. no separate UART-to-USB adapter
            wired up), such as during PC-vs-ESP32 validation.

endmenu
```

## scripts/lms-filter/Kconfig
```kconfig
menu "FXLMS ANC demo"

    config FXLMS_SAMPLE_RATE_HZ
        int "Sample rate"
        default 16000
        range 8000 48000
        help
            Default sample rate used by the PC simulation.

    config FXLMS_TAPS
        int "Number of adaptive controller taps"
        default 64
        range 1 512
        help
            FIR length of the adaptive ANC controller G(z).

    config FXLMS_MU_Q15
        int "Normalized filtered-x LMS learning rate in Q15"
        default 3000
        range 0 32767
        help
            Normalized (NLMS-style) learning rate encoded as Q15, i.e. 32767
            corresponds to a step of ~1.0. The update divides this value by the
            filtered-x power, so it is independent of input level and of the
            number of reference/actuator channels. Typical stable range is
            roughly 0.1-0.7 (3277-22938); smaller values improve stability.

    config FXLMS_ADAPT_SHIFT
        int "Extra FXLMS adaptation right shift"
        default 0
        range 0 30
        help
            Optional additional right shift applied to the already normalized
            controller-weight update. Usually left at 0.

    config FXLMS_OUTPUT_LIMIT
        int "Output saturation limit"
        default 32767
        range 1 32767
        help
            Absolute saturation limit for output samples.

endmenu
```

## scripts/lms-filter/sdkconfig.defaults
```kconfig
CONFIG_FXLMS_SAMPLE_RATE_HZ=16000
CONFIG_FXLMS_TAPS=64
CONFIG_FXLMS_MU_Q15=64
CONFIG_FXLMS_ADAPT_SHIFT=0
CONFIG_FXLMS_OUTPUT_LIMIT=32767
```

## fw/bom-node/components/ota/Kconfig
```kconfig
menu "OTA"

    config OTA_CURRENT_VERSION
        string "Current firmware version"
        default "0.0.0"
        help
            Current firmware version reported to OTAdrive.

    config OTA_API_KEY
        string "OTAdrive API key"
        default ""
        help
            API key used for OTAdrive device authentication.

endmenu
```

## fw/bom-node/main/Kconfig.projbuild
```kconfig
menu "Boomchecker"

    menu "OTA"
        config OTA_CURRENT_VERSION
            string "Current firmware version"
            default "0.0.0"
            help
                Current firmware version reported to OTAdrive.

        config OTA_API_KEY
            string "OTAdrive API key"
            default ""
            help
                API key used for OTAdrive device authentication.
    endmenu

    menu "WiFi"
        config MIDDLEWARE_WIFI_SSID
            string "WiFi SSID"
            default ""
            help
                SSID used for WiFi station connection.

        config MIDDLEWARE_WIFI_PASSWORD
            string "WiFi password"
            default ""
            help
                Password used for WiFi station connection.
    endmenu

endmenu
```

## fw/bom-node/middleware/wifi/Kconfig
```kconfig
menu "WiFi"

    config MIDDLEWARE_WIFI_SSID
        string "WiFi SSID"
        default ""
        help
            SSID used for WiFi station connection.

    config MIDDLEWARE_WIFI_PASSWORD
        string "WiFi password"
        default ""
        help
            Password used for WiFi station connection.

endmenu
```
